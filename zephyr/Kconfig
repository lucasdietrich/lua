## zephyr/Kconfig
```kconfig
menuconfig LUA
        bool "Enable LUA module"
        depends on !NEWLIB_LIBC_NANO
        default n
        help
          Enable support for LUA

if LUA

module = LUA
module-str = LUA

endif
```
